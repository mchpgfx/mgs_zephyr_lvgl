## drivers/gpu/microchip_gc520ul/Kconfig
```kconfig
config GPU_MICROCHIP_GC520UL
	bool "Microchip GC520UL 2D GPU (GPU2DC) driver"
	default y
	depends on DT_HAS_MICROCHIP_GC520UL_ENABLED
	help
	  Enable the Verisilicon GC520UL 2D GPU driver. Brings up the GPU2DC
	  core via the nano2D library (built as a separate Zephyr module) and
	  routes the GPU interrupt to nano2D event handling. Also gates the
	  compilation of the nano2D library module.

if GPU_MICROCHIP_GC520UL

config GPU_MICROCHIP_GC520UL_HEAP_SIZE
	int "GC520UL GPU heap size (bytes)"
	default 1048576
	range 65536 4194304
	help
	  Size of the contiguous, identity-mapped, non-cached heap handed to
	  nano2D for its device context and per-commit command buffers. The driver
	  reserves this as a static __nocache buffer and the consumer HAL manages
	  it with a Zephyr k_heap (n2d_hal_allocate/free).

	  1 MB is ample for the FILL+IMAGE command stream. This value also sizes
	  the non-cached MMU region, so do not over-provision it.

config GPU_MICROCHIP_GC520UL_INIT_PRIORITY
	int "GC520UL init priority"
	default 90
	help
	  Device init priority (POST_KERNEL). Must be greater than the display
	  init priorities so the system heap and display are ready first.

module = GPU_MICROCHIP_GC520UL
module-str = GC520UL 2D GPU
source "subsys/logging/Kconfig.template.log_config"

endif # GPU_MICROCHIP_GC520UL
```

## drivers/input/Kconfig
```kconfig
config INPUT_MICROCHIP_MAXTOUCH
	bool "Microchip maXTouch capacitive touch controller"
	default y
	depends on DT_HAS_MICROCHIP_MAXTOUCH_ENABLED
	depends on INPUT
	select I2C
	select GPIO
	select INPUT_TOUCH
	help
	  Enable support for Microchip maXTouch capacitive touch
	  controllers over I2C with multitouch support.

if INPUT_MICROCHIP_MAXTOUCH

config INPUT_MICROCHIP_MAXTOUCH_MAX_TOUCHES
	int "Maximum simultaneous touch points"
	default 10
	range 1 16
	help
	  Maximum number of simultaneous touch points to track.
	  Higher values use more RAM for touch state tracking.

config INPUT_MICROCHIP_MAXTOUCH_PERIOD_MS
	int "Polling period in ms (when no IRQ)"
	default 5
	range 5 100
	help
	  Touch polling interval when operating without an interrupt GPIO.
	  Lower values give faster response but use more CPU.

config INPUT_MICROCHIP_MAXTOUCH_INTERRUPT
	bool
	default y if $(dt_compat_any_has_prop,$(DT_COMPAT_MICROCHIP_MAXTOUCH),irq-gpios)
	help
	  Auto-selected when irq-gpios is present in the device tree node.
	  When disabled, the driver uses polling mode via k_timer.

endif # INPUT_MICROCHIP_MAXTOUCH
```

## dts/bindings/display/microchip,sam-lvdsc.yaml
```yaml
description: |
  Microchip SAM LVDSC (LVDS Serializer Controller)

  Converts parallel DPI output from the XLCDC to LVDS signaling.

  Example:

    lvdsc: lvdsc@e1424000 {
        compatible = "microchip,sam-lvdsc";
        reg = <0xe1424000 0x100>;
        dpi-input-type = "24-bit";
        dc-mode = "unbalanced";
        mapping = "jeida";
    };

compatible: "microchip,sam-lvdsc"

include: [base.yaml]

properties:
  reg:
    required: true

  dpi-input-type:
    type: string
    required: true
    description: |
      DPI input pixel size from XLCDC. Written to LVDSC_CFGR.LCDC_PIXSIZE.
    enum:
      - "24-bit"
      - "18-bit"

  dc-mode:
    type: string
    default: "unbalanced"
    description: |
      DC balance mode. Written to LVDSC_CFGR.DC_BAL.
    enum:
      - "unbalanced"
      - "balanced"

  mapping:
    type: string
    default: "jeida"
    description: |
      LVDS data mapping format. Written to LVDSC_CFGR.MAPPING.
      Only applicable when dc-mode is "unbalanced".
    enum:
      - "vesa"
      - "jeida"

  lane-a3-bit:
    type: int
    default: 0
    description: |
      Lane A3 reserved bit value. Written to LVDSC_UCBR.RESA3.
      0 or 1.

  dc-bias:
    type: int
    default: 9
    description: |
      DC bias value. Written to LVDSC_ACR.DCBIAS. Range 0-31.

  pre-emphasis-clk:
    type: int
    default: 0
    description: |
      Clock lane pre-emphasis. Written to LVDSC_ACR.PREEMP_CLK1.
      Range 0-7.

  pre-emphasis-a0:
    type: int
    default: 0
    description: Data lane A0 pre-emphasis. Range 0-7.

  pre-emphasis-a1:
    type: int
    default: 0
    description: Data lane A1 pre-emphasis. Range 0-7.

  pre-emphasis-a2:
    type: int
    default: 0
    description: Data lane A2 pre-emphasis. Range 0-7.

  pre-emphasis-a3:
    type: int
    default: 0
    description: Data lane A3 pre-emphasis. Range 0-7.
```

## dts/bindings/display/microchip,sama7d65-xlcdc.yaml
```yaml
description: |
  Microchip SAMA7D65 XLCDC variant (3 layers, no OVR2, GCLK max 90MHz).
  See microchip,sam-xlcdc.yaml for full property documentation.

compatible: "microchip,sama7d65-xlcdc"

include: microchip,sam-xlcdc.yaml
```

## dts/bindings/gpu/microchip,gc520ul.yaml
```yaml
# Copyright (c) 2026 Microchip Technology Inc.
# SPDX-License-Identifier: Apache-2.0

description: Microchip GC520UL (Verisilicon) 2D GPU / GPU2DC

compatible: "microchip,gc520ul"

include: base.yaml

properties:
  reg:
    required: true

  interrupts:
    required: true
```

## sama7d65_curiosity_ac69t88a/drivers/display/microchip_sam_xlcdc/Kconfig
```kconfig
config DISPLAY_MICROCHIP_SAM_XLCDC
    bool "Microchip SAM XLCDC Parent Driver"
    default y
    depends on DT_HAS_MICROCHIP_SAM9X7_XLCDC_ENABLED || DT_HAS_MICROCHIP_SAMA7D65_XLCDC_ENABLED
    help
      Enable support for the Microchip SAM XLCDC display controller parent
      device. Manages clocks, timing engine, LVDSPLL, and backlight.
      Layers are handled by the separate layer driver below.

config DISPLAY_MICROCHIP_SAM_XLCDC_LAYER
    bool "Microchip SAM XLCDC Layer Device Driver"
    default y
    depends on DISPLAY_MICROCHIP_SAM_XLCDC
    depends on DT_HAS_MICROCHIP_SAM_XLCDC_LAYER_ENABLED
    select DISPLAY
    help
      Per-layer display devices for the XLCDC controller. Each layer
      (base, ovr1, heo, ovr2) registers as its own display device
      implementing display_driver_api.

config XLCDC_LAYER_INIT_PRIORITY
    int "XLCDC layer init priority"
    default 86
    depends on DISPLAY_MICROCHIP_SAM_XLCDC_LAYER
    help
      Initialization priority for XLCDC layer devices.
      Must be higher than CONFIG_DISPLAY_INIT_PRIORITY (default 85)
      so the parent XLCDC is initialized first.

if DISPLAY_MICROCHIP_SAM_XLCDC

config MICROCHIP_SAM_XLCDC_DOUBLE_BUFFER
    bool "Enable double buffering"
    default n
    help
      Enable double buffering for tear-free display updates.
      Requires twice the framebuffer memory.

config MICROCHIP_SAM_XLCDC_LOG_REGS
    bool "Log register writes during init"
    default n
    help
      Log all register writes during driver initialization for debugging.

endif # DISPLAY_MICROCHIP_SAM_XLCDC

config DISPLAY_MICROCHIP_SAM_LVDSC
    bool "Microchip SAM LVDSC Bridge Driver"
    default y
    depends on DT_HAS_MICROCHIP_SAM_LVDSC_ENABLED
    help
      Enable support for the Microchip SAM LVDSC (LVDS Serializer Controller).
      Converts parallel DPI output to LVDS signaling.

config MICROCHIP_SAM_LVDSC_INIT_PRIORITY
    int "LVDSC bridge init priority"
    default 79
    depends on DISPLAY_MICROCHIP_SAM_LVDSC
    help
      Initialization priority for the LVDSC bridge driver.
      Must be lower than CONFIG_DISPLAY_INIT_PRIORITY (default 85)
      so the bridge is ready before the XLCDC driver starts.
```

## sama7d65_curiosity_ac69t88a/drivers/input/Kconfig
```kconfig
config INPUT_MICROCHIP_MAXTOUCH
	bool "Microchip maXTouch capacitive touch controller"
	default y
	depends on DT_HAS_MICROCHIP_MAXTOUCH_ENABLED
	depends on INPUT
	select I2C
	select GPIO
	select INPUT_TOUCH
	help
	  Enable support for Microchip maXTouch capacitive touch
	  controllers over I2C with multitouch support.

if INPUT_MICROCHIP_MAXTOUCH

config INPUT_MICROCHIP_MAXTOUCH_MAX_TOUCHES
	int "Maximum simultaneous touch points"
	default 10
	range 1 16
	help
	  Maximum number of simultaneous touch points to track.
	  Higher values use more RAM for touch state tracking.

config INPUT_MICROCHIP_MAXTOUCH_PERIOD_MS
	int "Polling period in ms (when no IRQ)"
	default 5
	range 5 100
	help
	  Touch polling interval when operating without an interrupt GPIO.
	  Lower values give faster response but use more CPU.

config INPUT_MICROCHIP_MAXTOUCH_INTERRUPT
	bool
	default y if $(dt_compat_any_has_prop,$(DT_COMPAT_MICROCHIP_MAXTOUCH),irq-gpios)
	help
	  Auto-selected when irq-gpios is present in the device tree node.
	  When disabled, the driver uses polling mode via k_timer.

config INPUT_MICROCHIP_MAXTOUCH_THREAD_STACK_SIZE
	int "Drain thread stack size"
	default 1024
	help
	  Stack size for the message-drain thread. The thread performs I2C
	  reads and input_report() calls.

config INPUT_MICROCHIP_MAXTOUCH_THREAD_PRIORITY
	int "Drain thread priority"
	default 5
	help
	  Priority of the message-drain thread. The default is preemptible so
	  the driver does not delay higher-priority application threads while
	  it waits for the CHG line to deassert. Use a cooperative (negative)
	  value only if touch latency matters more than application deadlines.

endif # INPUT_MICROCHIP_MAXTOUCH
```

## sama7d65_curiosity_ac69t88a/dts/bindings/display/microchip,sam-xlcdc-layer.yaml
```yaml
description: |
  Microchip SAM XLCDC display layer device.

  Each layer (base, ovr1, heo, ovr2) registers as its own display device
  implementing display_driver_api. Must be a child node of an XLCDC
  controller (microchip,sam9x7-xlcdc or microchip,sama7d65-xlcdc).

  Example:

    base_layer: layer-base@0 {
        compatible = "microchip,sam-xlcdc-layer";
        reg = <0>;
        layer-type = "base";
    };

    ovr1_layer: layer-ovr1@1 {
        compatible = "microchip,sam-xlcdc-layer";
        reg = <1>;
        layer-type = "ovr1";
        global-alpha = <180>;
        default-color = <0 0 0>;
    };

    heo_layer: layer-heo@2 {
        compatible = "microchip,sam-xlcdc-layer";
        reg = <2>;
        layer-type = "heo";
        heo-video-priority;
    };

compatible: "microchip,sam-xlcdc-layer"

properties:
  reg:
    type: int
    required: true
    description: |
      Layer index: 0=base, 1=ovr1, 2=heo, 3=ovr2.

  layer-type:
    type: string
    required: true
    description: Hardware layer selection.
    enum:
      - "base"
      - "ovr1"
      - "heo"
      - "ovr2"

  pixel-format:
    type: int
    description: |
      Per-layer RGB color mode override. If omitted, inherits the parent
      XLCDC pixel-format value.

  default-color:
    type: array
    description: |
      Default layer color when DMA is disabled. Three element array
      <R G B> with values 0-255. Default is <0 0 0>.

  global-alpha:
    type: int
    default: 255
    description: |
      Global alpha value for overlay blending (0=transparent, 255=opaque).
      Written to xCFG9/xCFG12 A0 field. Ignored for base layer.

  heo-video-priority:
    type: boolean
    description: |
      When set, HEO layer is rendered above OVR1 in the layer stack.
      Only applies to HEO layer type. Written to HEOCFG12.VIDPRI.

  width:
    type: int
    description: |
      Layer width in pixels. If omitted, the driver inherits the parent
      XLCDC width at runtime. For overlay layers, the framebuffer is
      allocated to this size (saves memory vs full-screen). Must not
      exceed 2048 (11-bit hardware register). Also required when this
      node is used as zephyr,display chosen for LVGL.

  height:
    type: int
    description: |
      Layer height in pixels. If omitted, the driver inherits the parent
      XLCDC height at runtime. For overlay layers, the framebuffer is
      allocated to this size (saves memory vs full-screen). Must not
      exceed 2048 (11-bit hardware register). Also required when this
      node is used as zephyr,display chosen for LVGL.

  x-origin:
    type: int
    default: 0
    description: |
      Horizontal position of the overlay window on the display, in pixels.
      11-bit hardware register (0-2047). x-origin + width must not exceed
      the parent XLCDC width. Ignored for base layer. Default 0.

  y-origin:
    type: int
    default: 0
    description: |
      Vertical position of the overlay window on the display, in pixels.
      11-bit hardware register (0-2047). y-origin + height must not exceed
      the parent XLCDC height. Ignored for base layer. Default 0.

  no-alloc-framebuffer:
    type: boolean
    description: |
      When set, the driver does NOT allocate its own framebuffer at init.
      The caller (e.g. LVGL) owns the pixel buffers and passes them via
      display_write(). Only full-screen writes are supported in this mode;
      partial writes return -ENOTSUP. Saves framebuffer memory when using
      LVGL with CONFIG_LV_Z_FULL_REFRESH and CONFIG_LV_Z_DOUBLE_VDB.

  framebuffer-memory:
    type: array
    description: |
      Optional fixed address and size pair for this layer's framebuffer.
      If omitted, the layer allocates from the system heap at runtime.
```
